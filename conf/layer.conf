## conf/layer.conf
```bitbake
# We might have a conf and classes directory, append to BBPATH
BBPATH .= ":${LAYERDIR}"

# We have a recipes directory, add to BBFILES
BBFILES += "${LAYERDIR}/recipes*/*/*.bb ${LAYERDIR}/recipes*/*/*.bbappend"

BBFILE_COLLECTIONS += "meta-edk2-hikey"
BBFILE_PATTERN_meta-edk2-hikey := "^${LAYERDIR}/"
BBFILE_PRIORITY_meta-edk2-hikey = "9"

INITRAMFS_IMAGE_BUNDLE = "1"
INITRAMFS_IMAGE = "rdk-secure-initramfs"
INITRAMFS_FSTYPES = "cpio.gz"
```
